## sdkconfig.defaults
```kconfig
CONFIG_ESPTOOLPY_FLASHSIZE_4MB=y
CONFIG_ESP_WIFI_AP_SSID="MeuESP"
CONFIG_ESP_WIFI_AP_PASSWORD="esp123456"
CONFIG_ESP_WIFI_AP_CHANNEL=1
CONFIG_ESP_MAX_STA_AP_CONN=4
CONFIG_ESP_WIFI_SSID="AndroidAP9030"
CONFIG_ESP_WIFI_PASSWORD="dmiy1985"
```
